## meta-oe/conf/distro/include/meta_oe_lto.inc
```bitbake
LTO_pn-liboauth = ""
LTO_pn-faad2 = ""
LTO_pn-giflib = ""
LTO_pn-breakpad = ""
LTO_pn-liboil = ""
LTO_pn-xfsprogs = ""
LTO_pn-libtinyxml = ""
LTO_pn-dibbler = ""
LTO_pn-libdevmapper = ""
LTO_pn-libaio = ""
LTO_pn-fuse = ""
```
